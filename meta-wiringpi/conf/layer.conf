## meta-wiringpi/conf/layer.conf
```bitbake
# We have a conf and classes directory, append to BBPATH
BBPATH .= ":${LAYERDIR}"

# We have a recipes directory containing .bb and .bbappend files, add to BBFILES
BBFILES += "${LAYERDIR}/recipes*/*/*.bb \ 
            ${LAYERDIR}/recipes*/*/*.bbappend"

BBFILE_COLLECTIONS += "wiringpi"
BBFILE_PATTERN_wiringpi := "^${LAYERDIR}/"
BBFILE_PRIORITY_wiringpi = "9"

LAYERSERIES_COMPAT_wiringpi = "kirkstone"
```

## rasp-build/conf/bblayers.conf
```bitbake
# POKY_BBLAYERS_CONF_VERSION is increased each time build/conf/bblayers.conf
# changes incompatibly
POKY_BBLAYERS_CONF_VERSION = "2"

BBPATH = "${TOPDIR}"
BBFILES ?= ""

BBLAYERS ?= " \
  /home/anon/Dev/yocto/poky/meta \
  /home/anon/Dev/yocto/poky/meta-poky \
  /home/anon/Dev/yocto/poky/meta-yocto-bsp \
  /home/anon/Dev/yocto/meta-raspberrypi \
  "
```
